## board/noble/kernel.its
```
/dts-v1/;

/ {
    description = "Galaxy Note 5 boot image";

    images {
        kernel {
            description = "kernel";
            data = /incbin/("./zImage");
            type = "kernel";
            arch = "arm";
            os = "linux";
            compression = "none";
            load = <0x40000000>;
            entry = <0x40000000>;
            hash-1 {
                algo = "md5";
            };
            hash-2 {
                algo = "sha1";
            };
        };

        exynos7420-N920 {
            description = "exynos7420-n920.dtb";
            data = /incbin/("./exynos7420-n920.dtb");
            type = "flat_dt";
            arch = "arm";
            compression = "none";
            load = <0x60000000>;
            hash-1 {
                algo = "crc32";
            };
        };

        ramdisk {
            description = "buildroot ramdisk";
            data = /incbin/("./rootfs.cpio.lzma");
            type = "ramdisk";
            arch = "arm";
            os = "linux";
            compression = "lzma";
            hash-1 {
                algo = "crc32";
            };
        };
    };

    configurations {
        exynos7420-N920 {
            description = "exynos7420-N920";
            kernel = "kernel";
            fdt = "exynos7420-N920";
            ramdisk = "ramdisk";
        };

    };
};
```

## configs/samsung_noblelte_defconfig
```kconfig
BR2_aarch64=y
BR2_cortex_a57_a53=y
BR2_ARM_ENABLE_NEON=y
BR2_ARM_ENABLE_VFP=y
BR2_CCACHE=y
BR2_CCACHE_DIR="/mnt/android/buildroot/.ccache"
BR2_CCACHE_INITIAL_SETUP="--max-size 10G"
BR2_TOOLCHAIN_BUILDROOT_GLIBC=y
BR2_KERNEL_HEADERS_5_2=y
BR2_BINUTILS_VERSION_2_32_X=y
BR2_GCC_VERSION_8_X=y
BR2_TOOLCHAIN_BUILDROOT_CXX=y
BR2_TARGET_GENERIC_HOSTNAME="noble"
BR2_TARGET_GENERIC_ROOT_PASSWD="root"
BR2_TARGET_GENERIC_GETTY=y
BR2_TARGET_GENERIC_GETTY_PORT="ttyGS0"
BR2_ROOTFS_OVERLAY="$(BR2_EXTERNAL_NOBLE_PATH)/board/midas/rootfs-overlay/"
#BR2_ROOTFS_POST_IMAGE_SCRIPT="$(BR2_EXTERNAL_NOBLE_PATH)/board/noble/post-image.sh"
BR2_LINUX_KERNEL=y
BR2_LINUX_KERNEL_CUSTOM_GIT=y
BR2_LINUX_KERNEL_CUSTOM_REPO_URL="https://github.com/Uramekus/linux.git"
BR2_LINUX_KERNEL_CUSTOM_REPO_VERSION="master"
BR2_LINUX_KERNEL_DEFCONFIG="noble"
BR2_LINUX_KERNEL_DTS_SUPPORT=y
BR2_LINUX_KERNEL_INTREE_DTS_NAME="exynos7420-N920"
BR2_KERNEL_HEADERS_CUSTOM_GIT=y
BR2_KERNEL_HEADERS_CUSTOM_REPO_URL="https://github.com/Uramekus/linux.git"
BR2_KERNEL_HEADERS_CUSTOM_REPO_VERSION="master"
BR2_PACKAGE_HOST_LINUX_HEADERS_CUSTOM_5_2=y
BR2_PACKAGE_LINUX_TOOLS_GPIO=y
BR2_PACKAGE_BUSYBOX_SHOW_OTHERS=y
#BR2_PACKAGE_ALSA_UTILS=y
#BR2_PACKAGE_ALSA_UTILS_APLAY=y
#BR2_PACKAGE_MPG123=y
BR2_PACKAGE_EVTEST=y
BR2_PACKAGE_I2C_TOOLS=y
#BR2_PACKAGE_TINYALSA=y
BR2_PACKAGE_LIBARCHIVE=y
BR2_PACKAGE_LIBARCHIVE_BSDTAR=y
BR2_PACKAGE_DTC=y
#BR2_PACKAGE_LIBNFC=y
#BR2_PACKAGE_LIBNFC_EXAMPLES=y
BR2_PACKAGE_CRDA=y
BR2_PACKAGE_DHCPCD=y
BR2_PACKAGE_DNSMASQ=y
# BR2_PACKAGE_DNSMASQ_TFTP is not set
BR2_PACKAGE_IW=y
BR2_PACKAGE_NETCAT=y
BR2_PACKAGE_OPENSSH=y
BR2_PACKAGE_WPA_SUPPLICANT=y
BR2_PACKAGE_WPA_SUPPLICANT_AUTOSCAN=y
BR2_PACKAGE_WPA_SUPPLICANT_EAP=y
BR2_PACKAGE_WPA_SUPPLICANT_CLI=y
BR2_PACKAGE_MKSH=y
BR2_PACKAGE_UTIL_LINUX_BINARIES=y
BR2_TARGET_ROOTFS_CPIO=y
BR2_TARGET_ROOTFS_CPIO_LZMA=y
```
